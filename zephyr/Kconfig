## zephyr/Kconfig
```kconfig
config GALE_KERNEL_SEM
	bool "Use Gale formally verified semaphore"
	depends on MULTITHREADING
	help
	  Replace kernel/sem.c with the Gale formally verified Rust
	  implementation. Requires a Rust toolchain for the target
	  architecture.

if GALE_KERNEL_SEM

config GALE_MAX_SEMS
	int "Maximum number of Gale semaphores"
	default 32
	help
	  Maximum number of concurrently active semaphores. Each
	  semaphore is pre-allocated from a static pool at build time.

config GALE_MAX_WAITERS
	int "Maximum waiters per semaphore"
	default 16
	help
	  Maximum number of threads that can block on a single
	  semaphore. Bounded by the heapless::Vec in gale::WaitQueue.

endif # GALE_KERNEL_SEM

config GALE_KERNEL_MUTEX
	bool "Use Gale formally verified mutex"
	depends on MULTITHREADING
	help
	  Replace kernel/mutex.c with the Gale formally verified Rust
	  implementation. The ownership validation and lock_count
	  arithmetic are handled by verified Rust code. Wait queue,
	  scheduling, and priority inheritance remain native Zephyr C.
	  Requires a Rust toolchain for the target architecture.

config GALE_KERNEL_CONDVAR
	bool "Use Gale formally verified condvar"
	depends on MULTITHREADING
	help
	  Mark kernel/condvar.c wait queue operations as verified by
	  Gale. Condvar is a pure wait queue wrapper with no FFI —
	  the upstream condvar.c is still compiled, but its wait queue
	  operations are covered by Gale's Verus proofs.

config GALE_KERNEL_MSGQ
	bool "Use Gale formally verified message queue"
	help
	  Replace kernel/msg_q.c with the Gale formally verified Rust
	  implementation. The ring buffer index arithmetic is handled
	  by verified Rust code. Wait queue, scheduling, memcpy,
	  polling, and tracing remain native Zephyr C.
	  Requires a Rust toolchain for the target architecture.

config GALE_KERNEL_STACK
	bool "Use Gale formally verified stack"
	depends on MULTITHREADING
	help
	  Replace kernel/stack.c with the Gale formally verified Rust
	  implementation. The LIFO capacity check and count tracking
	  are handled by verified Rust code. Wait queue, scheduling,
	  data storage, and tracing remain native Zephyr C.
	  Requires a Rust toolchain for the target architecture.

config GALE_KERNEL_PIPE
	bool "Use Gale formally verified pipe"
	depends on MULTITHREADING
	help
	  Replace kernel/pipe.c with the Gale formally verified Rust
	  implementation. The state machine validation and byte count
	  computation are handled by verified Rust code. Ring buffer
	  data transfer, wait queues, scheduling, direct-copy, and
	  tracing remain native Zephyr C.
	  Requires a Rust toolchain for the target architecture.

config GALE_KERNEL_EVENT
	bool "Use Gale formally verified event"
	depends on MULTITHREADING
	depends on EVENTS
	help
	  Replace kernel/events.c with the Gale formally verified Rust
	  implementation. The bitmask operations (post, set, clear,
	  set_masked, wait condition checks) are handled by verified
	  Rust code. Wait queues, scheduling, tracing, and userspace
	  remain native Zephyr C.
	  Requires a Rust toolchain for the target architecture.

config GALE_KERNEL_MEM_SLAB
	bool "Use Gale formally verified memory slab"
	help
	  Replace kernel/mem_slab.c with the Gale formally verified Rust
	  implementation. The block count tracking (num_used increment
	  and decrement) is handled by verified Rust code. Free-list
	  management, wait queues, scheduling, pointer validation,
	  statistics, and tracing remain native Zephyr C.
	  Requires a Rust toolchain for the target architecture.

config GALE_KERNEL_TIMER
	bool "Use Gale formally verified timer"
	depends on MULTITHREADING
	help
	  Use Gale formally verified status counter arithmetic for
	  kernel/timer.c. The status increment (checked for overflow)
	  and status read-reset operations are handled by verified
	  Rust code. Timeout scheduling, callbacks, work queues, and
	  tracing remain native Zephyr C.
	  Requires a Rust toolchain for the target architecture.

config GALE_KERNEL_FIFO
	bool "Use Gale formally verified fifo"
	depends on MULTITHREADING
	help
	  Replace the k_fifo count tracking in kernel/queue.c with the
	  Gale formally verified Rust implementation. The unbounded
	  queue counter increment/decrement is handled by verified
	  Rust code. Linked list management, wait queues, scheduling,
	  alloc nodes, polling, and tracing remain native Zephyr C.
	  Requires a Rust toolchain for the target architecture.

config GALE_KERNEL_LIFO
	bool "Use Gale formally verified lifo"
	depends on MULTITHREADING
	help
	  Replace the k_lifo count tracking in kernel/queue.c with the
	  Gale formally verified Rust implementation. The unbounded
	  queue counter increment/decrement is handled by verified
	  Rust code. Linked list management, wait queues, scheduling,
	  alloc nodes, polling, and tracing remain native Zephyr C.
	  Requires a Rust toolchain for the target architecture.

config GALE_KERNEL_QUEUE
	bool "Use Gale formally verified queue"
	depends on MULTITHREADING
	help
	  Replace kernel/queue.c with the Gale formally verified Rust
	  implementation. The unbounded queue counter for append,
	  prepend, and get operations is handled by verified Rust code.
	  Linked list management, wait queues, scheduling, alloc nodes,
	  polling, and tracing remain native Zephyr C.
	  Requires a Rust toolchain for the target architecture.

config GALE_KERNEL_MBOX
	bool "Use Gale formally verified mailbox"
	depends on MULTITHREADING
	help
	  Replace kernel/mailbox.c with the Gale formally verified Rust
	  implementation. The send validation, message ID matching, and
	  data exchange size computation are handled by verified Rust
	  code. Wait queues, scheduling, async message descriptors,
	  data copy, and tracing remain native Zephyr C.
	  Requires a Rust toolchain for the target architecture.

config GALE_KERNEL_TIMEOUT
	bool "Use Gale formally verified timeout"
	help
	  Use Gale formally verified tick arithmetic for kernel/timeout.c.
	  Deadline computation, overflow checks, and expiry detection are
	  handled by verified Rust code. Linked-list management, spinlock,
	  callbacks, and hardware timer remain native Zephyr C.
	  Requires a Rust toolchain for the target architecture.

config GALE_KERNEL_POLL
	bool "Use Gale formally verified poll"
	depends on MULTITHREADING
	help
	  Use Gale formally verified poll event state machine for
	  kernel/poll.c. Event initialization, condition checks, and
	  signal raise/reset are handled by verified Rust code. Wait
	  queues, thread scheduling, and work queue integration remain
	  native Zephyr C.
	  Requires a Rust toolchain for the target architecture.

config GALE_KERNEL_FUTEX
	bool "Use Gale formally verified futex"
	depends on MULTITHREADING
	help
	  Use Gale formally verified value comparison for kernel/futex.c.
	  The wait condition check and wake count tracking are handled
	  by verified Rust code. Spinlock, wait queue, scheduling, and
	  timeout remain native Zephyr C.
	  Requires a Rust toolchain for the target architecture.

config GALE_KERNEL_TIMESLICE
	bool "Use Gale formally verified timeslice"
	depends on MULTITHREADING
	help
	  Use Gale formally verified tick accounting for
	  kernel/timeslicing.c. Time-slice reset, tick decrement, and
	  expiry detection are handled by verified Rust code. Timeout
	  scheduling, IPI dispatch, and per-CPU arrays remain native
	  Zephyr C.
	  Requires a Rust toolchain for the target architecture.

config GALE_KERNEL_KHEAP
	bool "Use Gale formally verified kheap"
	help
	  Use Gale formally verified byte-level allocation tracking for
	  kernel/kheap.c. Allocation and free byte counting with overflow
	  and underflow protection are handled by verified Rust code.
	  sys_heap internals, free-list, coalescing, wait queues, and
	  tracing remain native Zephyr C.
	  Requires a Rust toolchain for the target architecture.

config GALE_KERNEL_THREAD_LIFECYCLE
	bool "Use Gale formally verified thread lifecycle"
	depends on MULTITHREADING
	help
	  Use Gale formally verified thread create/exit counting and
	  priority validation for kernel/thread.c. Thread count tracking
	  and priority range validation are handled by verified Rust
	  code. Stack setup, TLS, naming, scheduling, and arch-specific
	  initialization remain native Zephyr C.
	  Requires a Rust toolchain for the target architecture.

config GALE_KERNEL_WORK
	bool "Use Gale formally verified work"
	depends on MULTITHREADING
	help
	  Use Gale formally verified work item state machine for
	  kernel/work.c. Submit and cancel state flag management are
	  handled by verified Rust code. Queue management, scheduling,
	  handler dispatch, and delayable work remain native Zephyr C.
	  Requires a Rust toolchain for the target architecture.

config GALE_KERNEL_FATAL
	bool "Use Gale formally verified fatal"
	help
	  Use Gale formally verified fatal error classification for
	  kernel/fatal.c. Recovery action determination based on error
	  reason and context is handled by verified Rust code. IRQ lock,
	  coredump, thread abort, and halt remain native Zephyr C.
	  Requires a Rust toolchain for the target architecture.

config GALE_KERNEL_MEMPOOL
	bool "Use Gale formally verified mempool"
	help
	  Use Gale formally verified fixed-block pool allocation tracking.
	  Block count increment/decrement with bounds checking are handled
	  by verified Rust code. Bitarray management, alignment, and actual
	  memory allocation remain native Zephyr C.
	  Requires a Rust toolchain for the target architecture.

config GALE_KERNEL_DYNAMIC
	bool "Use Gale formally verified dynamic"
	depends on MULTITHREADING
	help
	  Use Gale formally verified dynamic thread pool tracking for
	  kernel/dynamic.c. Stack pool active count tracking is handled
	  by verified Rust code. Bitarray management, stack allocation,
	  and thread creation remain native Zephyr C.
	  Requires a Rust toolchain for the target architecture.

config GALE_KERNEL_SMP_STATE
	bool "Use Gale formally verified SMP state"
	depends on SMP
	help
	  Use Gale formally verified SMP CPU state tracking for
	  kernel/smp.c. CPU start/stop count tracking is handled by
	  verified Rust code. IPI signaling, interrupt stack setup,
	  and arch CPU start remain native Zephyr C.
	  Requires a Rust toolchain for the target architecture.

config GALE_KERNEL_SCHED
	bool "Use Gale formally verified scheduler"
	depends on MULTITHREADING
	help
	  Use Gale formally verified scheduler primitives for
	  kernel/sched.c. next_up thread selection and preemption
	  decision logic are handled by verified Rust code. Run queue
	  data structures, thread state transitions, wait queues, and
	  SMP IPI remain native Zephyr C.
	  Requires a Rust toolchain for the target architecture.
```
