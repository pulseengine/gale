## CMakeLists.txt
```
# SPDX-License-Identifier: Apache-2.0
#
# Engine-control interrupt benchmark.
#
# Simulates a crank-position sensor firing at the rate of a 4-stroke ICE
# sweeping 500 → 10,000 RPM. Each simulated interrupt runs the Zephyr
# primitive chain (spinlock + ring_buf + k_sem give-from-isr + scheduler
# wake) that Gale replaces, allowing a back-to-back baseline-vs-Gale
# latency/jitter comparison.
#
# Build baseline:
#   west build -b qemu_cortex_m3 -s benches/engine_control \
#     -d /tmp/engine-baseline
#
# Build with Gale primitives:
#   west build -b qemu_cortex_m3 -s benches/engine_control \
#     -d /tmp/engine-gale \
#     -- -DZEPHYR_EXTRA_MODULES=<gale-root> \
#        -DOVERLAY_CONFIG=<gale>/zephyr/gale_overlay.conf

cmake_minimum_required(VERSION 3.20)

# If CTF tracing-to-UART is enabled (via prj-ctf.conf overlay), QEMU
# needs a second -serial entry to redirect uart1 (the chosen
# zephyr,tracing-uart) to a capture file. Without this QEMU drops the
# second UART silently. QEMU_EXTRA_FLAGS must be populated before
# find_package(Zephyr) because qemu.cmake reads it during board setup.
#
# Detection is coarse: grep the passed OVERLAY_CONFIG for "prj-ctf"
# (our filename convention). This avoids polluting default baseline /
# gale CI runs (which don't pass prj-ctf.conf) with an extra capture
# file in every build dir. An explicit -DENGINE_BENCH_CTF=y also works.
if(BOARD MATCHES "qemu_.*")
  set(_engine_ctf_enabled OFF)
  if(ENGINE_BENCH_CTF)
    set(_engine_ctf_enabled ON)
  elseif(DEFINED OVERLAY_CONFIG AND "${OVERLAY_CONFIG}" MATCHES "prj-ctf")
    set(_engine_ctf_enabled ON)
  endif()

  if(_engine_ctf_enabled)
    list(APPEND QEMU_EXTRA_FLAGS -serial file:channel0_0)
    # DT overlay binding zephyr,tracing-uart = &uart1. Kept out of the
    # default bench boards/ dir so baseline + gale runs don't pick it
    # up and silently mutate the DT chosen nodes.
    if(NOT DEFINED DTC_OVERLAY_FILE)
      set(DTC_OVERLAY_FILE
          "${CMAKE_CURRENT_LIST_DIR}/tracing_ctf/qemu_cortex_m3.overlay")
    else()
      set(DTC_OVERLAY_FILE
          "${DTC_OVERLAY_FILE};${CMAKE_CURRENT_LIST_DIR}/tracing_ctf/qemu_cortex_m3.overlay")
    endif()
    message(STATUS "engine_control: CTF tracing enabled — "
                   "uart1 → <build>/channel0_0")
  endif()
endif()

find_package(Zephyr REQUIRED HINTS $ENV{ZEPHYR_BASE})
project(gale_engine_control)

target_sources(app PRIVATE
  src/main.c
  src/control.c
  src/tables.c
  src/smart_dwt.c
)
target_include_directories(app PRIVATE src)

# MCU self-monitoring backend: vendor-specific where we have one AND
# the ADC is enabled. The G4 backend uses Zephyr's ADC API; on builds
# that explicitly disable ADC (e.g. the LTO experiments where the
# ADC IRQ-table interaction crashes the chip), fall back to the stub
# so the CSV row format stays uniform regardless of the variant.
if(CONFIG_SOC_SERIES_STM32G4X AND CONFIG_ADC)
  target_sources(app PRIVATE src/smart_mcu_g4.c)
else()
  target_sources(app PRIVATE src/smart_mcu_stub.c)
endif()

# -DENGINE_BENCH_TOTAL_SAMPLES=N on the west build line becomes
# -DTOTAL_SAMPLES=N to the compiler. Default is 150 (QEMU smoke-test
# friendly); Renode long runs pass 10000+.
if(DEFINED ENGINE_BENCH_TOTAL_SAMPLES)
  target_compile_definitions(app PRIVATE
    TOTAL_SAMPLES=${ENGINE_BENCH_TOTAL_SAMPLES}u)
endif()

# Sweep schedule override (same shape): -DENGINE_BENCH_SWEEP=long picks
# a richer RPM profile; "short" is the default.
if(DEFINED ENGINE_BENCH_SWEEP)
  target_compile_definitions(app PRIVATE
    ENGINE_BENCH_SWEEP_${ENGINE_BENCH_SWEEP}=1)
endif()
```

## prj.conf
```kconfig
# Engine-control benchmark — base config.
#
# Keeps CONFIG_GALE_KERNEL_* off by default. Apply gale_overlay.conf
# on the second build to swap Gale primitives in.

CONFIG_STDOUT_CONSOLE=y
CONFIG_MAIN_STACK_SIZE=4096
CONFIG_ISR_STACK_SIZE=2048

# Enable the primitives the benchmark exercises in the ISR / thread path.
CONFIG_EVENTS=y
CONFIG_RING_BUFFER=y
# 2048-sample ring (32 KB) is needed to absorb high-RPM ISR bursts on
# real silicon at 115200-baud UART throughput without dropping samples.
# RING_BUFFER_LARGE lifts Zephyr's static-assertion size cap so
# RING_BUF_DECLARE accepts the larger backing array. Inert for the
# QEMU/Renode CI lanes (their drops were 0 already at the smaller ring).
CONFIG_RING_BUFFER_LARGE=y

# Pump tick rate up so k_timer can approximate 10 μs periods
# (default is 10 ms / 100 Hz, way too coarse for 60 kHz targets).
# 100 kHz tick = 10 μs granularity, enough to hit ~3 kHz crank rate.
# Past that we need the counter subsystem — wire that in on iteration 2.
CONFIG_SYS_CLOCK_TICKS_PER_SEC=100000

# Cycle counter: must be accurate for latency measurement.
CONFIG_TIMING_FUNCTIONS=y

# No logging noise from the hot path. The benchmark writes CSV to
# console only from the main thread at end-of-run.
CONFIG_LOG=n
CONFIG_CBPRINTF_NANO=y
```

## prj-ctf.conf
```kconfig
# Engine-control benchmark — CTF tracing overlay.
#
# Overlays on top of prj.conf (and optionally prj-gale.conf) to enable
# Zephyr's Common Trace Format tracing subsystem. CTF packets are emitted
# for every kernel object operation already hooked by Gale's shims
# (k_sem_*, k_timer_*, thread switches, ISR entry/exit), so wiring this
# in doesn't require touching the bench source.
#
# Does NOT replace the poor-man's CSV event stream in src/main.c. The CSV
# goes to UART0 (console); CTF goes to UART1 (tracing-uart), captured by
# QEMU via a second `-serial` redirect to a file (see
# tracing_ctf/run-ctf.sh). Both streams are recorded in parallel.
#
# Usage:
#   west build -b qemu_cortex_m3 -s benches/engine_control \
#     -d /tmp/engine-ctf \
#     -- -DOVERLAY_CONFIG=benches/engine_control/prj-ctf.conf
#
# Combine with gale primitives (CTF + gale_sem + gale_timer paths):
#   -DOVERLAY_CONFIG="benches/engine_control/prj-gale.conf;benches/engine_control/prj-ctf.conf"

CONFIG_TRACING=y
CONFIG_TRACING_CTF=y
CONFIG_TRACING_BACKEND_UART=y
CONFIG_TRACING_ASYNC=y
CONFIG_TRACING_BUFFER_SIZE=4096

# CTF needs timestamps for event ordering + latency analysis.
CONFIG_TRACING_CTF_TIMESTAMP=y

# Async tracing spawns a worker thread at default prio; pin below the
# reader so we never preempt the measurement-critical emit_event path.
CONFIG_TRACING_THREAD_PRIORITY=6
CONFIG_TRACING_THREAD_STACK_SIZE=1024

# Thread names help correlate CTF events to bench threads (sweep, reader,
# tracing) when decoding offline.
CONFIG_THREAD_NAME=y
```

## prj-gale.conf
```kconfig
# Engine-control benchmark — Gale overlay.
#
# Applied on top of prj.conf to swap Gale's verified primitives into
# the ISR/thread critical path. Only the primitives this benchmark
# actually exercises; adding more would bloat the build without
# affecting measurements.
#
# Note on coverage:
#   Only CONFIG_GALE_KERNEL_SEM differs behaviourally between the two
#   builds on the bench hot path — k_sem_give is the only Gale primitive
#   the ISR calls through to. CONFIG_GALE_KERNEL_TIMER and
#   CONFIG_GALE_KERNEL_SPINLOCK compile in but have no direct call sites
#   inside control_step or the handoff. They're kept on here to exercise
#   the module wiring; if you need a single-primitive isolation experiment,
#   comment them out.
#
#   CONFIG_GALE_KERNEL_SPINLOCK_VALIDATE was previously listed but silently
#   dropped in Kconfig resolution (depends on SMP, not present on
#   qemu_cortex_m3). Removed to avoid the false impression it's active.
#
# Usage:
#   west build -b qemu_cortex_m3 -s benches/engine_control \
#     -d /tmp/engine-gale \
#     -- -DZEPHYR_EXTRA_MODULES=<abs-path-to-gale> \
#        -DOVERLAY_CONFIG=benches/engine_control/prj-gale.conf

CONFIG_GALE_KERNEL_SEM=y
CONFIG_GALE_KERNEL_TIMER=y
CONFIG_GALE_KERNEL_SPINLOCK=y
```

## boards/nucleo_g474re.conf
```kconfig
# NUCLEO-G474RE bench Kconfig overlay — enables ADC for smart-data MCU
# health snapshots (smart_mcu_g4.c).
#
# The DT overlay in `boards/nucleo_g474re.overlay` puts ADC1 + the
# two internal channels (TS=ch16, VREFINT=ch18) in place; without
# CONFIG_ADC, the driver source isn't compiled in and the
# DEVICE_DT_GET(DT_NODELABEL(adc1)) call in smart_mcu_g4.c fails to
# link with `undefined reference to __device_dts_ord_*`.
#
# CONFIG_ADC_STM32 auto-selects when CONFIG_ADC=y and the DT compatible
# match fires.

CONFIG_ADC=y
```

## boards/nucleo_g474re.overlay
```dts
/*
 * SPDX-License-Identifier: Apache-2.0
 * Copyright (c) 2026 PulseEngine
 *
 * NUCLEO-G474RE bench overlay — enable ADC1 internal channels
 * for smart-data MCU health snapshots.
 *
 * Zephyr's stock nucleo_g474re DTS leaves ADC1 disabled; the
 * silicon-anchor protocol needs it to read the on-die temperature
 * sensor (TS, channel 16) and internal reference (VREFINT,
 * channel 18) so the H-row in the captured CSV records actual
 * thermal and supply state alongside the algorithm timings.
 *
 * Channel numbers per STM32G474RE reference manual RM0440 §21.4.31
 * (ADC channels) — TS = IN16, VREFINT = IN18.
 */

&adc1 {
	status = "okay";
	st,adc-clock-source = "SYNC";
	st,adc-prescaler = <4>;
	pinctrl-0 = <>;
	pinctrl-names = "default";

	#address-cells = <1>;
	#size-cells = <0>;

	channel@10 {
		reg = <16>;
		zephyr,gain = "ADC_GAIN_1";
		zephyr,reference = "ADC_REF_INTERNAL";
		zephyr,acquisition-time = <ADC_ACQ_TIME_MAX>;
		zephyr,resolution = <12>;
	};

	channel@12 {
		reg = <18>;
		zephyr,gain = "ADC_GAIN_1";
		zephyr,reference = "ADC_REF_INTERNAL";
		zephyr,acquisition-time = <ADC_ACQ_TIME_MAX>;
		zephyr,resolution = <12>;
	};
};
```

## src/main.c
```c
/*
 * SPDX-License-Identifier: Apache-2.0
 * Copyright (c) 2026 PulseEngine
 *
 * Engine-control interrupt benchmark — main app (event-stream edition).
 *
 * A k_timer callback (ISR context) simulates a crank-position sensor.
 * Each firing runs a pure-C engine-control algorithm (table lookups
 * for spark advance + fuel duration), then exercises the Zephyr
 * primitive chain Gale replaces (ring_buf_put + k_sem_give).
 *
 * Two timings are recorded per interrupt:
 *
 *   algo_cycles    = t_algo_end - t_entry   # pure C algorithm
 *   handoff_cycles = t_exit - t_algo_end    # ring_buf + sem_give
 *
 * Methodology (post-#25):
 *   The ISR no longer computes statistics. It records the two raw
 *   cycle deltas per sample and the sweep-step index, then the
 *   reader thread emits one CSV event line per sample to UART:
 *
 *     E,<seq>,<step>,<rpm>,<algo_cycles>,<handoff_cycles>
 *
 *   Off-target analyzer (analyze.py) groups events by RPM step and
 *   computes median + bootstrap 95% CI + Mann-Whitney U p-value on
 *   the per-step distributions. No on-target mean/min/max/histogram.
 *
 * Why: the in-ISR histogram approach had a mean-divisor mismatch
 * (histogram totals diverged from reader `count`) and log-scale
 * buckets masked sub-bucket shifts. Emitting raw events puts all
 * statistics off the target where they can be recomputed and audited.
 * See docs/research/engine-bench-methodology-review.md and #25.
 */

#include <zephyr/kernel.h>
#include <zephyr/sys/ring_buffer.h>
#include <stdbool.h>
#include <stdio.h>
#include <stdlib.h>
#include <string.h>

#include "control.h"
#include "smart_dwt.h"
#include "smart_mcu.h"

/* ------------------------------------------------------------- knobs */

/* Sized to absorb the biggest single-step ISR burst on real silicon
 * without dropping. The long-sweep's largest step is 1000 samples
 * (steps 3-7); even with the reader stuck on a full UART buffer for
 * the duration of the burst, 2048 fits 1000 with headroom. RAM cost:
 * 2048 × sizeof(crank_sample) ≈ 32 KB on STM32G4 (16 KB→48 KB,
 * 12% → 37% of the 128 KB SRAM). Previous value (256) caused 56%
 * sample drops at high RPM under 115200-baud UART throughput,
 * biasing per-RPM medians.
 *
 * The large ring is gated on real STM32G4 silicon: that is the only
 * target with both the 128 KB SRAM to hold it AND the real 115200-baud
 * UART back-pressure that caused the drops. The QEMU/Renode CI lanes
 * run on lm3s6965 (64 KB SRAM) where 32 KB of `noinit` overflows RAM,
 * and they never dropped a sample at 256 (no real UART drain limit),
 * so they keep the smaller ring. */
#if defined(CONFIG_SOC_SERIES_STM32G4X)
#  define RING_CAPACITY_SAMPLES  2048
#else
#  define RING_CAPACITY_SAMPLES  256
#endif

struct sweep_step {
	uint32_t rpm;
	uint32_t samples;
};

#if defined(ENGINE_BENCH_SWEEP_long)
/* Renode / real-hardware long run — more RPM stations, more samples
 * each, captures the full idle→redline curve with statistical weight. */
static const struct sweep_step sweep[] = {
	{  500, 500 },   { 1000, 500 },   { 1500, 500 },
	{ 2000, 1000 },  { 2500, 1000 },  { 3000, 1000 },
	{ 4000, 1000 },  { 5000, 1000 },  { 6000,  500 },
	{ 7000,  300 },  { 8000,  200 },  { 9000,  150 },
	{10000,  100 },
};
#else
/* QEMU smoke / short interactive run. */
static const struct sweep_step sweep[] = {
	{ 1000, 30 },
	{ 2000, 30 },
	{ 4000, 30 },
	{ 6000, 30 },
	{10000, 30 },
};
#endif
#define SWEEP_STEPS (sizeof(sweep) / sizeof(sweep[0]))

/* TOTAL_SAMPLES must equal sum(sweep[].samples) so every step runs to
 * completion. Computed at compile time from the sweep array to avoid
 * the audit-flagged bug where TOTAL_SAMPLES=150 truncated the short
 * sweep at step 2 of 5 (RPM 1000 + 2000 only). If you override via
 * -DENGINE_BENCH_TOTAL_SAMPLES, make sure it matches sum(sweep[].samples)
 * or accept that the sweep may terminate early. */
#if defined(ENGINE_BENCH_SWEEP_long)
#  ifndef TOTAL_SAMPLES
#    define TOTAL_SAMPLES  7750u  /* sum of long sweep above */
#  endif
#else
#  ifndef TOTAL_SAMPLES
#    define TOTAL_SAMPLES  150u   /* 5 steps × 30 samples */
#  endif
#endif

/* For a 4-stroke engine with one interrupt per crank degree:
 *   period_us = 60_000_000 / (rpm * 360) = 166_667 / rpm. */
static inline uint32_t rpm_to_period_us(uint32_t rpm)
{
	if (rpm == 0) {
		return 1000000U;
	}
	return 166667U / rpm;
}

/* ------------------------------------------------------------- state */

static struct k_timer crank_timer;
static struct k_sem   data_ready;

RING_BUF_DECLARE(sample_ring, RING_CAPACITY_SAMPLES * sizeof(struct crank_sample));

static volatile uint32_t g_rpm      = 500U;
static volatile uint8_t  g_step     = 0U;    /* sweep index, written by driver */
static volatile uint16_t g_load_pct = 45U;
static volatile int16_t  g_coolant  = 85;
static volatile uint8_t  g_knock    = 0;

static volatile uint32_t g_angle      = 0U;
static volatile uint16_t g_seq        = 0U;
static volatile uint16_t g_drops      = 0U;
static volatile uint32_t g_interrupts = 0U;

/* Per-step "fire this many times then stop" limit. Written by the
 * sweep driver before each step, decremented by the ISR. When it
 * hits zero the ISR stops the timer so overshoot is bounded to the
 * one extra shot that may have queued. Without this, high-RPM steps
 * would fire hundreds of times before the driver's k_msleep(1) poll
 * could notice the sample count had been reached. */
static volatile uint32_t g_fire_budget = 0U;

/* End-of-sweep handshake. sweep_driver sets this true after its final
 * drain; reader_loop polls it (with a short k_sem_take timeout) so
 * the bench terminates cleanly even when high-RPM steps drop samples
 * and `count` plateaus below TOTAL_SAMPLES. */
static volatile bool g_sweep_done = false;

/* Side-channel array for handoff_cycles. The ISR measures t_exit AFTER
 * ring_buf_put (which is the point — handoff cost includes the put +
 * sem_give). But by then the sample bytes are already in the ring, so
 * we can't write handoff_cycles into the in-ring sample. We publish
 * the measurement here, keyed by seq mod RING_CAPACITY_SAMPLES. SPSC
 * ordering: the ISR always writes this slot before the reader can
 * observe the matching ring entry (reader wakes on k_sem_give, which
 * happens BEFORE t_exit is read). */
static volatile uint32_t g_handoff_by_slot[RING_CAPACITY_SAMPLES];

/* ---------------------------------------------------------------- ISR */

static void crank_isr(struct k_timer *t)
{
	ARG_UNUSED(t);

	uint32_t t_entry = k_cycle_get_32();

	struct engine_state in = {
		.rpm          = g_rpm,
		.load_pct     = g_load_pct,
		.coolant_c    = g_coolant,
		.knock_retard = g_knock,
	};
	int16_t spark;
	uint16_t fuel;
	control_step(&in, &spark, &fuel);

	uint32_t t_algo_end = k_cycle_get_32();

	uint32_t seq_snapshot = g_seq;
	uint32_t algo_cycles = t_algo_end - t_entry;

	struct crank_sample s = {
		.angle_deg         = g_angle,
		.rpm               = in.rpm,
		.algo_cycles       = algo_cycles,
		.spark_advance_deg = spark,
		.fuel_duration_us  = fuel,
		.drops_so_far      = g_drops,
		.seq               = (uint16_t)seq_snapshot,
		.step              = g_step,
	};

	uint32_t wrote = ring_buf_put(&sample_ring, (uint8_t *)&s, sizeof(s));
	if (wrote != sizeof(s)) {
		g_drops++;
	} else {
		k_sem_give(&data_ready);
	}

	uint32_t t_exit = k_cycle_get_32();
	uint32_t handoff_cycles = t_exit - t_algo_end;

	/* Publish handoff into a side channel indexed by seq. The ring
	 * buffer is SPSC: the consumer sees a sample only after this
	 * ISR completes (it ran to k_sem_give already but the consumer
	 * thread can't preempt ISR), so writing the slot here is still
	 * before the consumer observes the matching sample. */
	g_handoff_by_slot[seq_snapshot % RING_CAPACITY_SAMPLES] = handoff_cycles;

	g_seq++;
	g_angle = (g_angle + 1U) % 720U;
	g_interrupts++;

	if (g_fire_budget > 0U) {
		g_fire_budget--;
		if (g_fire_budget == 0U) {
			/* Stop the timer from ISR context: k_timer_stop is
			 * ISR-safe per Zephyr docs. This caps per-step
			 * overshoot to 1 extra firing (the one already in
			 * flight when we hit zero). */
			k_timer_stop(&crank_timer);
		}
	}
}

/* ---------------------------------------------------------- reporter */

static uint32_t count = 0;

/*
 * Bench framework overhead — measured at boot before any per-event
 * timing begins (see measure_overhead). Subtracted from every algo /
 * handoff cycle count emitted to the CSV stream so the published
 * numbers reflect work between the cycle-counter reads, not the cost
 * of the cycle-counter reads themselves. The measured value is also
 * emitted as a metadata line so reviewers can audit the compensation
 * step. Same idiom as Zephyr 4.4 ztest_bench's `ctrl` benchmark.
 */
#define OVERHEAD_SAMPLES 1000U
static uint32_t bench_overhead_cycles = 0U;

static int cmp_u32(const void *a, const void *b)
{
	uint32_t x = *(const uint32_t *)a;
	uint32_t y = *(const uint32_t *)b;
	return (x > y) - (x < y);
}

static void measure_overhead(void)
{
	static uint32_t samples[OVERHEAD_SAMPLES];
	unsigned int key = irq_lock();
	for (uint32_t i = 0; i < OVERHEAD_SAMPLES; i++) {
		uint32_t a = k_cycle_get_32();
		uint32_t b = k_cycle_get_32();
		samples[i] = b - a;
	}
	irq_unlock(key);
	qsort(samples, OVERHEAD_SAMPLES, sizeof(uint32_t), cmp_u32);
	bench_overhead_cycles = samples[OVERHEAD_SAMPLES / 2];  /* median */
}

/* Saturating subtraction — never report a negative cycle count. With
 * a quiet measurement window plus interrupt-locked overhead probe, the
 * compensated value should rarely if ever underflow, but we clip to 0
 * defensively rather than silently wrapping. */
static inline uint32_t compensate(uint32_t raw)
{
	return raw > bench_overhead_cycles ? raw - bench_overhead_cycles : 0U;
}

static void emit_event(const struct crank_sample *s)
{
	uint32_t handoff = g_handoff_by_slot[s->seq % RING_CAPACITY_SAMPLES];
	printf("E,%u,%u,%u,%u,%u\n",
	       (unsigned)s->seq, (unsigned)s->step, (unsigned)s->rpm,
	       (unsigned)compensate(s->algo_cycles),
	       (unsigned)compensate(handoff));
}

static void reader_loop(void)
{
	/* Exit when sweep_driver has signalled done AND the ring is fully
	 * drained. Use a 500 ms semaphore timeout so we wake periodically
	 * to re-check the exit condition even if no samples are arriving
	 * (which is the normal end-of-sweep state). The previous design
	 * waited K_FOREVER on the semaphore and exited only when
	 * `count >= TOTAL_SAMPLES`, which hangs the bench whenever a
	 * step drops samples (count never catches up). */
	while (!g_sweep_done
	       || ring_buf_size_get(&sample_ring) >= sizeof(struct crank_sample)) {
		if (k_sem_take(&data_ready, K_MSEC(500)) != 0) {
			/* Semaphore timeout — loop back and re-check the exit
			 * condition. If the sweep is still firing, the next
			 * sample will give the semaphore quickly. If we're at
			 * end-of-sweep, the loop guard will see g_sweep_done
			 * and exit. */
			continue;
		}
		struct crank_sample s;
		while (ring_buf_get(&sample_ring, (uint8_t *)&s, sizeof(s))
		       == sizeof(s)) {
			emit_event(&s);
			count++;
		}
	}
}

static void print_csv_header(void)
{
	uint32_t hz = sys_clock_hw_cycles_per_sec();
	printf("=== ENGINE-CONTROL BENCH RESULTS ===\n");
	printf("build,%s\n",
#ifdef CONFIG_GALE_KERNEL_SEM
	       "gale"
#else
	       "baseline"
#endif
	);
	printf("cycles_per_sec,%u\n", hz);
	printf("target_samples,%u\n", TOTAL_SAMPLES);
	/* Visible compensation: every algo / handoff value below has had
	 * this many cycles subtracted. Median of 1000 empty cycle-counter
	 * read pairs measured at boot under irq_lock (see measure_overhead). */
	printf("overhead_cycles,%u\n", bench_overhead_cycles);
	printf("# event rows: E,<seq>,<step>,<rpm>,<algo_cycles>,<handoff_cycles>\n");
	printf("# algo / handoff cycles are AFTER subtracting overhead_cycles\n");
	printf("# DWT rows:   D,<at>,<cyccnt>,<cpicnt>,<exccnt>,<sleepcnt>,<lsucnt>,<foldcnt>\n");
	printf("# health rows:H,<at>,<temp_mC>,<vref_mV>,<vbat_mV>\n");

	struct dwt_snapshot d;
	smart_dwt_snapshot(&d);
	smart_dwt_emit("boot", &d);

	struct mcu_health h;
	smart_mcu_snapshot(&h);
	smart_mcu_emit("boot", &h);
}

static void print_csv_footer(void)
{
	struct dwt_snapshot d;
	smart_dwt_snapshot(&d);
	smart_dwt_emit("end", &d);

	struct mcu_health h;
	smart_mcu_snapshot(&h);
	smart_mcu_emit("end", &h);

	printf("drops,%u\n", g_drops);
	printf("samples,%u\n", count);
	printf("=== END ===\n");
}

/* ------------------------------------------------------------- driver */

static void sweep_driver(void)
{
	for (size_t i = 0; i < SWEEP_STEPS; i++) {
		g_step = (uint8_t)i;
		g_rpm = sweep[i].rpm;
		uint32_t period_us = rpm_to_period_us(g_rpm);
		if (period_us == 0) period_us = 1;

		/* Set the ISR's fire-budget BEFORE starting the timer.
		 * The ISR will self-stop after exactly sweep[i].samples
		 * firings (bounded-overshoot design — cf. the audit which
		 * flagged polling-based termination). */
		uint32_t start_ints = g_interrupts;
		g_fire_budget = sweep[i].samples;
		k_timer_start(&crank_timer,
			      K_USEC(period_us),
			      K_USEC(period_us));

		/* Wait for the ISR to self-stop. Budget = theoretical
		 * duration + 2s floor for UART back-pressure that may
		 * stretch the observed period. */
		uint32_t budget_ms = sweep[i].samples * period_us / 1000U
				     + 2000U;
		uint32_t t0 = k_uptime_get_32();
		bool budget_exceeded = false;
		while (g_fire_budget > 0U) {
			if ((k_uptime_get_32() - t0) > budget_ms) {
				budget_exceeded = true;
				break;
			}
			k_msleep(5);
		}
		/* Belt-and-suspenders: if we exited via the budget, the ISR
		 * may still be armed; stop it here. k_timer_stop is
		 * idempotent. */
		k_timer_stop(&crank_timer);

		/* Drain between steps — the reader emits events over UART
		 * which is the slow path. Without this back-pressure the
		 * ring fills and subsequent ISRs drop samples. We wait for
		 * the ring to actually empty (rather than count to hit
		 * `target`, which can never happen when high-RPM steps drop
		 * samples). 30s ceiling so a stuck UART doesn't hang CI. */
		(void)start_ints;  /* sweep-step diagnostics only — see step printf below */
		uint32_t drain_t0 = k_uptime_get_32();
		bool drain_timeout = false;
		while (ring_buf_size_get(&sample_ring) >= sizeof(struct crank_sample)) {
			if ((k_uptime_get_32() - drain_t0) > 30000U) {
				drain_timeout = true;
				break;
			}
			k_msleep(5);
		}

		/* Now safe to emit step-completion marker: no ISR firing,
		 * reader has drained, so no interleaving with event lines.
		 * Using '#' prefix so analyze.py ignores these as comments. */
		printf("# step %u/%u rpm=%u period_us=%u ints=%u count=%u%s%s\n",
		       (unsigned)(i + 1), (unsigned)SWEEP_STEPS,
		       (unsigned)g_rpm, (unsigned)period_us,
		       (unsigned)(g_interrupts - start_ints),
		       (unsigned)count,
		       budget_exceeded ? " [budget_exceeded]" : "",
		       drain_timeout   ? " [drain_timeout]"   : "");

		/* Smart-data per-step boundary: DWT + MCU health. Same
		 * "ISR is quiescent, reader has drained" guarantees as
		 * the marker printf — no interleaving with E rows. */
		char tag[16];
		snprintf(tag, sizeof(tag), "step_%u", (unsigned)(i + 1));
		struct dwt_snapshot d;
		smart_dwt_snapshot(&d);
		smart_dwt_emit(tag, &d);
		struct mcu_health h;
		smart_mcu_snapshot(&h);
		smart_mcu_emit(tag, &h);
	}
	/* Final drain — wait for the ring to fully empty so the reader can
	 * emit any in-flight samples before we signal end-of-sweep. */
	uint32_t final_t0 = k_uptime_get_32();
	while (ring_buf_size_get(&sample_ring) >= sizeof(struct crank_sample)) {
		if ((k_uptime_get_32() - final_t0) > 30000U) {
			printk("final drain timeout; count=%u\n", (unsigned)count);
			break;
		}
		k_msleep(5);
	}
	/* Signal end-of-sweep. reader_loop polls this with a 500 ms
	 * semaphore timeout and exits cleanly even when high-RPM steps
	 * dropped samples (count plateaus below TOTAL_SAMPLES). */
	g_sweep_done = true;
}

/* -------------------------------------------------------------- main */

int main(void)
{
	k_sem_init(&data_ready, 0, K_SEM_MAX_LIMIT);
	k_timer_init(&crank_timer, crank_isr, NULL);

	/* Pre-header banner via printk: goes out BEFORE we start the
	 * sweep thread / reader, so it can't interleave with event
	 * lines. The CSV header follows immediately. */
	printk("engine_control bench starting "
	       "(target %u samples, %u sweep steps)\n",
	       TOTAL_SAMPLES, (unsigned)SWEEP_STEPS);

	/* Bring up smart-data sources before any benchmarking work so the
	 * boot snapshot in print_csv_header reflects a clean state. DWT
	 * is universally available on ARMv7-M; MCU health may be a stub. */
	smart_dwt_enable();
	(void)smart_mcu_init();

	k_thread_priority_set(k_current_get(), 5);

	/* Measure framework overhead BEFORE the CSV header so the value
	 * is recorded in the header line. Runs at thread context with
	 * IRQs locked for the inner loop only — no other threads exist
	 * yet, so this is the quietest the system will ever be. */
	measure_overhead();

	/* Emit CSV header BEFORE starting the sweep so stdout ordering
	 * is deterministic: header, then events interleaved with sweep
	 * progress printk, then footer. */
	print_csv_header();

	static K_THREAD_STACK_DEFINE(sweep_stack, 1024);
	static struct k_thread sweep_thread;
	k_thread_create(&sweep_thread, sweep_stack,
			K_THREAD_STACK_SIZEOF(sweep_stack),
			(k_thread_entry_t)sweep_driver, NULL, NULL, NULL,
			4, 0, K_NO_WAIT);

	reader_loop();
	k_timer_stop(&crank_timer);
	print_csv_footer();
	return 0;
}
```

## src/control.c
```c
/*
 * SPDX-License-Identifier: Apache-2.0
 * Copyright (c) 2026 PulseEngine
 *
 * Pure control algorithm: table lookups + small integer corrections.
 * No divides, no memory allocation, no floating point. Bounded
 * execution time by construction — Gale's verification-friendly style.
 */

#include "control.h"
#include <stdint.h>

#define RPM_BINS  20
#define LOAD_BINS 20

extern const int8_t  spark_advance_table[RPM_BINS][LOAD_BINS];
extern const uint16_t fuel_duration_table[RPM_BINS][LOAD_BINS];

static inline uint8_t rpm_bin(uint32_t rpm)
{
	uint32_t b = rpm / 500;   /* 500 RPM per bin */
	if (b >= RPM_BINS) {
		b = RPM_BINS - 1;
	}
	return (uint8_t)b;
}

static inline uint8_t load_bin(uint16_t load_pct)
{
	uint16_t b = load_pct / 5; /* 5 % per bin */
	if (b >= LOAD_BINS) {
		b = LOAD_BINS - 1;
	}
	return (uint8_t)b;
}

/*
 * Coolant correction: below 80 °C we enrich fuel up to +30 % at 0 °C;
 * above 80 °C no correction; below 0 °C clamp at +30 %.
 * Integer-only: avoid any floating point.
 */
static inline uint32_t coolant_enrichment_permille(int16_t coolant_c)
{
	if (coolant_c >= 80) {
		return 0;
	}
	if (coolant_c <= 0) {
		return 300;   /* +30 % */
	}
	/* Linear from 300 permille at 0 °C to 0 permille at 80 °C. */
	return (uint32_t)((80 - coolant_c) * 300 / 80);
}

void control_step(const struct engine_state *in,
		  int16_t *spark_advance_deg,
		  uint16_t *fuel_duration_us)
{
	uint8_t rb = rpm_bin(in->rpm);
	uint8_t lb = load_bin(in->load_pct);

	int16_t advance = (int16_t)spark_advance_table[rb][lb];
	/* Apply knock retard (borrows from the base advance, saturating to 0). */
	advance -= (int16_t)in->knock_retard;
	if (advance < 0) {
		advance = 0;
	}
	*spark_advance_deg = advance;

	uint32_t base_fuel = (uint32_t)fuel_duration_table[rb][lb];
	uint32_t enrich = coolant_enrichment_permille(in->coolant_c);
	uint32_t corrected = base_fuel + (base_fuel * enrich / 1000U);
	if (corrected > UINT16_MAX) {
		corrected = UINT16_MAX;
	}
	*fuel_duration_us = (uint16_t)corrected;
}
```

## src/control.h
```c
/*
 * SPDX-License-Identifier: Apache-2.0
 * Copyright (c) 2026 PulseEngine
 *
 * Engine control algorithm: ignition advance + fuel duration.
 * Realistic-ish but deliberately bounded — only table lookups +
 * small integer arithmetic, no divides, no allocation. The point
 * is to exercise the Zephyr primitive chain around the ISR, not
 * to be an actual ECU.
 */

#ifndef GALE_BENCH_CONTROL_H
#define GALE_BENCH_CONTROL_H

#include <stdint.h>

/* Per-ISR sample — what the "crank" writes to the ring buffer.
 *
 * Post-#25 (event-stream methodology): carries the pre-handoff cycle
 * delta (algo_cycles) and the sweep-step index. The handoff cycle
 * count is measured AFTER ring_buf_put + k_sem_give, at which point
 * the sample is already in the ring — so it is published via a
 * side-channel array (main.c: g_handoff_by_slot) keyed by seq. The
 * reader pairs them up when emitting the event line. */
struct crank_sample {
	uint32_t angle_deg;        /* 0..719 for a 4-stroke cycle */
	uint32_t rpm;              /* current engine speed */
	uint32_t algo_cycles;      /* t_algo_end - t_entry, measured in ISR */
	int16_t  spark_advance_deg;/* computed by control_step */
	uint16_t fuel_duration_us; /* computed by control_step */
	uint16_t drops_so_far;     /* monotonic ring-buffer drop count */
	uint16_t seq;              /* sequence number (wraps); also indexes
	                            * the handoff side-channel slot */
	uint8_t  step;             /* sweep-step index (0..SWEEP_STEPS-1) */
};

/* Input vector sampled by the ISR from simulated sensors. */
struct engine_state {
	uint32_t rpm;
	uint16_t load_pct;      /* 0..100, simulated MAP */
	int16_t  coolant_c;     /* -40..+120 */
	uint8_t  knock_retard;  /* 0..15 degrees */
};

/*
 * Pure function: given sensor state, compute ignition advance and
 * fuel injection duration. No side effects.
 *
 * - spark_advance_deg: degrees before top dead centre (BTDC)
 * - fuel_duration_us: injector pulse width
 */
void control_step(const struct engine_state *in,
		  int16_t *spark_advance_deg,
		  uint16_t *fuel_duration_us);

#endif /* GALE_BENCH_CONTROL_H */
```

## src/smart_dwt.c
```c
/*
 * SPDX-License-Identifier: Apache-2.0
 * Copyright (c) 2026 PulseEngine
 *
 * DWT counter snapshot — implementation.
 *
 * Direct MMIO instead of CMSIS macros to keep this file independent
 * of which CMSIS header bundle Zephyr happens to ship for the target
 * SoC. The register addresses below are ARMv7-M architecture-defined
 * (DDI0403E.e §C1.6, "DWT Memory Map") and identical across Cortex-M3,
 * M4, and M7. ARMv8-M (M33/M55) is also compatible at this level.
 */

#include <stdint.h>
#include <stdio.h>

#include "smart_dwt.h"

#define DCB_DEMCR_ADDR     0xE000EDFCu  /* Debug Exception and Monitor Control */
#define DCB_DEMCR_TRCENA   (1u << 24)

#define DWT_CTRL_ADDR      0xE0001000u
#define DWT_CYCCNT_ADDR    0xE0001004u
#define DWT_CPICNT_ADDR    0xE0001008u
#define DWT_EXCCNT_ADDR    0xE000100Cu
#define DWT_SLEEPCNT_ADDR  0xE0001010u
#define DWT_LSUCNT_ADDR    0xE0001014u
#define DWT_FOLDCNT_ADDR   0xE0001018u

#define DWT_CTRL_CYCCNTENA (1u << 0)
#define DWT_CTRL_CPIEVTENA (1u << 17)
#define DWT_CTRL_EXCEVTENA (1u << 18)
#define DWT_CTRL_SLEEPEVT  (1u << 19)
#define DWT_CTRL_LSUEVTENA (1u << 20)
#define DWT_CTRL_FOLDEVTNA (1u << 21)
/* Hardware-level event-counter enables. The "EVTENA" bits gate the
 * external trace output for those events; the counters themselves
 * increment whenever the corresponding microarchitectural event
 * occurs. We set them anyway so that, if a future bench is hooked
 * up to a SWO trace probe, the events are visible there too. */

#define MMIO32(addr) (*(volatile uint32_t *)(uintptr_t)(addr))

void smart_dwt_enable(void)
{
	MMIO32(DCB_DEMCR_ADDR) |= DCB_DEMCR_TRCENA;

	/* Reset the counters to a known starting point. CYCCNT is a
	 * 32-bit field; the others are 8-bit fields in their own
	 * registers but writing 0 is the conventional reset. */
	MMIO32(DWT_CYCCNT_ADDR)   = 0u;
	MMIO32(DWT_CPICNT_ADDR)   = 0u;
	MMIO32(DWT_EXCCNT_ADDR)   = 0u;
	MMIO32(DWT_SLEEPCNT_ADDR) = 0u;
	MMIO32(DWT_LSUCNT_ADDR)   = 0u;
	MMIO32(DWT_FOLDCNT_ADDR)  = 0u;

	uint32_t ctrl = MMIO32(DWT_CTRL_ADDR);
	ctrl |= DWT_CTRL_CYCCNTENA
	     |  DWT_CTRL_CPIEVTENA
	     |  DWT_CTRL_EXCEVTENA
	     |  DWT_CTRL_SLEEPEVT
	     |  DWT_CTRL_LSUEVTENA
	     |  DWT_CTRL_FOLDEVTNA;
	MMIO32(DWT_CTRL_ADDR) = ctrl;
}

void smart_dwt_snapshot(struct dwt_snapshot *out)
{
	out->cyccnt   = MMIO32(DWT_CYCCNT_ADDR);
	out->cpicnt   = (uint8_t)(MMIO32(DWT_CPICNT_ADDR)   & 0xFFu);
	out->exccnt   = (uint8_t)(MMIO32(DWT_EXCCNT_ADDR)   & 0xFFu);
	out->sleepcnt = (uint8_t)(MMIO32(DWT_SLEEPCNT_ADDR) & 0xFFu);
	out->lsucnt   = (uint8_t)(MMIO32(DWT_LSUCNT_ADDR)   & 0xFFu);
	out->foldcnt  = (uint8_t)(MMIO32(DWT_FOLDCNT_ADDR)  & 0xFFu);
}

void smart_dwt_emit(const char *at, const struct dwt_snapshot *s)
{
	printf("D,%s,%u,%u,%u,%u,%u,%u\n",
	       at,
	       (unsigned)s->cyccnt,
	       (unsigned)s->cpicnt,
	       (unsigned)s->exccnt,
	       (unsigned)s->sleepcnt,
	       (unsigned)s->lsucnt,
	       (unsigned)s->foldcnt);
}
```

## src/smart_dwt.h
```c
/*
 * SPDX-License-Identifier: Apache-2.0
 * Copyright (c) 2026 PulseEngine
 *
 * DWT counter snapshot for the silicon-anchor protocol.
 *
 * On ARMv7-M the DWT (Data Watchpoint and Trace) unit exposes six
 * counters that quantify *why* a measured cycle count is what it
 * is — not just "how long did this take" but how much of it was
 * stalled on memory, on exceptions, on sleep, etc. A captured
 * silicon run that records these alongside the event timestamps
 * lets the analyzer discriminate "the runtime cost is real" from
 * "the runtime cost is a microarchitectural artefact".
 *
 *   CYCCNT   — full 32-bit cycle counter (wraps at 2^32)
 *   CPICNT   — 8-bit CPI overhead counter (extra cycles beyond 1 CPI)
 *   EXCCNT   — 8-bit exception entry/exit overhead counter
 *   SLEEPCNT — 8-bit sleep cycles counter
 *   LSUCNT   — 8-bit load/store unit additional cycles counter
 *   FOLDCNT  — 8-bit folded-instruction counter
 *
 * The five 8-bit counters wrap at 256, so the protocol takes a
 * snapshot at every RPM-step boundary; the analyzer computes
 * wrap-aware deltas. CYCCNT is wide enough to be safe across the
 * full sweep on any practical clock.
 *
 * On targets without a DWT unit (or where DWT is unimplemented in
 * the simulator — qemu_cortex_m3 in particular), all reads return
 * zero, so the row in the CSV is the literal value 0 across the
 * board and analyze.py treats that as "DWT not available" rather
 * than as a real measurement.
 */

#ifndef GALE_BENCH_SMART_DWT_H
#define GALE_BENCH_SMART_DWT_H

#include <stdint.h>

struct dwt_snapshot {
	uint32_t cyccnt;
	uint8_t  cpicnt;
	uint8_t  exccnt;
	uint8_t  sleepcnt;
	uint8_t  lsucnt;
	uint8_t  foldcnt;
};

/* Enable trace + all six counters. Idempotent. Must be called once
 * at boot before any snapshot. On targets without DWT this is a
 * no-op (the writes to memory-mapped registers are absorbed by the
 * simulator). */
void smart_dwt_enable(void);

/* Snapshot the current values. Cheap (six 32-bit MMIO reads). Safe
 * to call from thread or ISR context. */
void smart_dwt_snapshot(struct dwt_snapshot *out);

/* Emit one CSV row of the form
 *   D,<at>,<cyccnt>,<cpicnt>,<exccnt>,<sleepcnt>,<lsucnt>,<foldcnt>
 * where <at> is the event tag passed in (e.g. "boot", "step_3", "end"). */
void smart_dwt_emit(const char *at, const struct dwt_snapshot *s);

#endif /* GALE_BENCH_SMART_DWT_H */
```

## src/smart_mcu.h
```c
/*
 * SPDX-License-Identifier: Apache-2.0
 * Copyright (c) 2026 PulseEngine
 *
 * MCU self-monitoring snapshot — vendor-neutral interface.
 *
 * "Smart data" beyond DWT counters: did the chip stay in spec while
 * the bench was running? A capture made at +25 °C on cold silicon
 * and one made at +85 °C with the regulator drooping are not the
 * same measurement.  We record the chip's own telemetry so the
 * analyzer can flag a thermal- or supply-related anomaly rather
 * than mis-attributing it to the gale primitives.
 *
 * Each backend (smart_mcu_g4.c, smart_mcu_stub.c) implements this
 * interface for its target. The stub is selected for any board
 * that doesn't have a vendor-specific backend; it returns the
 * "not available" marker so the CSV row format stays the same.
 *
 *   H,<at>,<temp_mC>,<vref_mV>,<vbat_mV>
 *
 * `vbat_mV` is reported as 0 on parts without a VBAT divider channel.
 * Any field marked unavailable on a given backend is reported as 0
 * with a one-time `# H <field>: not available on this target`
 * comment line at boot.
 */

#ifndef GALE_BENCH_SMART_MCU_H
#define GALE_BENCH_SMART_MCU_H

#include <stdint.h>

struct mcu_health {
	int32_t  temp_mC;   /* die temperature in milli-degrees C */
	uint32_t vref_mV;   /* internal reference voltage, milli-volts */
	uint32_t vbat_mV;   /* VBAT pin voltage, mV; 0 if unavailable */
};

/* One-time init: opens the ADC + reads vendor calibration ROM.
 * Returns 0 on success; non-zero leaves the backend in
 * "snapshot returns zeroed health" mode (still safe to call).
 * Always emits a banner comment summarising what's available. */
int smart_mcu_init(void);

/* Snapshot the current readings. Reads ADC channels — costs a few
 * tens of microseconds. Safe from thread context only. */
void smart_mcu_snapshot(struct mcu_health *out);

/* Emit one CSV row:
 *   H,<at>,<temp_mC>,<vref_mV>,<vbat_mV> */
void smart_mcu_emit(const char *at, const struct mcu_health *h);

#endif /* GALE_BENCH_SMART_MCU_H */
```

## src/smart_mcu_g4.c
```c
/*
 * SPDX-License-Identifier: Apache-2.0
 * Copyright (c) 2026 PulseEngine
 *
 * STM32G4 MCU self-monitoring — die temperature and internal
 * reference voltage via ADC1.
 *
 * Calibration locations and formulas per STMicroelectronics
 * RM0440 (STM32G4 reference manual) §3.7.1 "Boot and start-up
 * memory areas" and §21 "ADC".
 *
 *   TS_CAL1     at 0x1FFF75A8 — TS reading at 30 °C, VDDA = 3.0 V
 *   TS_CAL2     at 0x1FFF75CA — TS reading at 130 °C, VDDA = 3.0 V
 *   VREFINT_CAL at 0x1FFF75AA — VREFINT reading at 30 °C, 3.0 V
 *
 * Formulas (RM0440 §21.4.32, §21.4.33):
 *
 *   actual_VREF_mV = 3000 * VREFINT_CAL / raw_VREFINT
 *
 *   temp_C = ((TS_CAL2_TEMP_C - TS_CAL1_TEMP_C) * (raw_TS_at_3V0 - TS_CAL1))
 *          / (TS_CAL2 - TS_CAL1) + TS_CAL1_TEMP_C
 *
 *   raw_TS_at_3V0 = raw_TS * actual_VREF_mV / 3000
 *     (correct the TS reading back to the calibration condition)
 *
 * VBAT is not exposed as an ADC channel on this Nucleo configuration
 * (no battery input), so we always report 0 for vbat_mV.
 */

#include <stdint.h>
#include <stdio.h>
#include <zephyr/devicetree.h>
#include <zephyr/drivers/adc.h>
#include <zephyr/sys/util.h>

#include "smart_mcu.h"

#define ADC_NODE          DT_NODELABEL(adc1)
#define ADC_RESOLUTION    12

#define ADC_CH_TS         16
#define ADC_CH_VREFINT    18

#define TS_CAL1_ADDR      ((const volatile uint16_t *)0x1FFF75A8u)
#define TS_CAL2_ADDR      ((const volatile uint16_t *)0x1FFF75CAu)
#define VREFINT_CAL_ADDR  ((const volatile uint16_t *)0x1FFF75AAu)
#define TS_CAL1_TEMP_C    30
#define TS_CAL2_TEMP_C    130
#define CAL_VREF_MV       3000

static const struct device *s_adc;
static int s_init_ok;

static int read_one(uint8_t channel_id, int16_t *out)
{
	int16_t buf;
	struct adc_sequence seq = {
		.channels    = BIT(channel_id),
		.buffer      = &buf,
		.buffer_size = sizeof(buf),
		.resolution  = ADC_RESOLUTION,
	};
	int ret = adc_read(s_adc, &seq);
	if (ret == 0) {
		*out = buf;
	}
	return ret;
}

static int setup_channel(uint8_t channel_id)
{
	struct adc_channel_cfg cfg = {
		.gain             = ADC_GAIN_1,
		.reference        = ADC_REF_INTERNAL,
		.acquisition_time = ADC_ACQ_TIME_MAX,
		.channel_id       = channel_id,
		.differential     = 0,
	};
	return adc_channel_setup(s_adc, &cfg);
}

int smart_mcu_init(void)
{
	s_adc = DEVICE_DT_GET(ADC_NODE);
	if (!device_is_ready(s_adc)) {
		printf("# H init: ADC1 device not ready — DT overlay missing?\n");
		return -1;
	}
	if (setup_channel(ADC_CH_TS) != 0) {
		printf("# H init: ADC1 ch%u (TS) setup failed\n", ADC_CH_TS);
		return -2;
	}
	if (setup_channel(ADC_CH_VREFINT) != 0) {
		printf("# H init: ADC1 ch%u (VREFINT) setup failed\n",
		       ADC_CH_VREFINT);
		return -3;
	}
	s_init_ok = 1;
	printf("# H ready: temp_mC,vref_mV via ADC1 ch%u + ch%u; "
	       "VBAT not wired (always 0)\n",
	       ADC_CH_TS, ADC_CH_VREFINT);
	printf("# H cal: TS_CAL1=%u@%dC TS_CAL2=%u@%dC VREFINT_CAL=%u@%dmV\n",
	       (unsigned)*TS_CAL1_ADDR, TS_CAL1_TEMP_C,
	       (unsigned)*TS_CAL2_ADDR, TS_CAL2_TEMP_C,
	       (unsigned)*VREFINT_CAL_ADDR, CAL_VREF_MV);
	return 0;
}

void smart_mcu_snapshot(struct mcu_health *out)
{
	out->vbat_mV = 0;

	if (!s_init_ok) {
		out->temp_mC = 0;
		out->vref_mV = 0;
		return;
	}

	int16_t raw_ts = 0, raw_vref = 0;
	if (read_one(ADC_CH_VREFINT, &raw_vref) != 0 || raw_vref == 0) {
		out->temp_mC = 0;
		out->vref_mV = 0;
		return;
	}
	if (read_one(ADC_CH_TS, &raw_ts) != 0) {
		out->temp_mC = 0;
		out->vref_mV = (uint32_t)CAL_VREF_MV
		             * (uint32_t)*VREFINT_CAL_ADDR
		             / (uint32_t)raw_vref;
		return;
	}

	uint32_t vref_cal = *VREFINT_CAL_ADDR;
	uint32_t actual_vref_mV = (uint32_t)CAL_VREF_MV * vref_cal
	                        / (uint32_t)raw_vref;

	/* Correct TS reading to the calibration's 3.0 V condition.
	 * raw_TS_at_3V0 = raw_TS * actual_VREF / 3.0V */
	int32_t raw_ts_at_3v0 = (int32_t)raw_ts
	                      * (int32_t)actual_vref_mV
	                      / CAL_VREF_MV;

	int32_t ts_cal1 = (int32_t)*TS_CAL1_ADDR;
	int32_t ts_cal2 = (int32_t)*TS_CAL2_ADDR;
	int32_t span_cal = ts_cal2 - ts_cal1;
	if (span_cal == 0) {
		/* Defensive: corrupted calibration ROM. */
		out->temp_mC = 0;
	} else {
		int32_t temp_C_x1000 =
			(int32_t)(TS_CAL2_TEMP_C - TS_CAL1_TEMP_C) * 1000
			* (raw_ts_at_3v0 - ts_cal1) / span_cal
			+ TS_CAL1_TEMP_C * 1000;
		out->temp_mC = temp_C_x1000;
	}
	out->vref_mV = actual_vref_mV;
}

void smart_mcu_emit(const char *at, const struct mcu_health *h)
{
	printf("H,%s,%d,%u,%u\n",
	       at, (int)h->temp_mC, (unsigned)h->vref_mV,
	       (unsigned)h->vbat_mV);
}
```

## src/smart_mcu_stub.c
```c
/*
 * SPDX-License-Identifier: Apache-2.0
 * Copyright (c) 2026 PulseEngine
 *
 * MCU self-monitoring — fallback stub for boards without a
 * vendor-specific backend (qemu_cortex_m3, mps2/an385, etc.).
 *
 * Every reading is reported as 0 / "unavailable". The CSV row
 * format stays identical so analyze.py can ingest captures from
 * stub and full-backend boards uniformly; the analyzer treats an
 * all-zero H row as "no MCU health on this target" rather than
 * "the chip is dead".
 */

#include <stdint.h>
#include <stdio.h>

#include "smart_mcu.h"

int smart_mcu_init(void)
{
	printf("# H temp_mC,vref_mV,vbat_mV: not available on this target "
	       "(stub backend)\n");
	return -1;
}

void smart_mcu_snapshot(struct mcu_health *out)
{
	out->temp_mC = 0;
	out->vref_mV = 0;
	out->vbat_mV = 0;
}

void smart_mcu_emit(const char *at, const struct mcu_health *h)
{
	printf("H,%s,%d,%u,%u\n",
	       at, (int)h->temp_mC, (unsigned)h->vref_mV, (unsigned)h->vbat_mV);
}
```
