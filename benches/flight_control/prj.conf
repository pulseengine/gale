## CMakeLists.txt
```
# SPDX-License-Identifier: Apache-2.0
#
# Flight-control macro benchmark.
#
# Composes ring_buf + sem + mutex + msgq + condvar on a 100 Hz fixed-rate
# control loop. Sibling of benches/engine_control/ which exercises only
# ring_buf + sem. See docs/research/macro-bench-design.md for the design
# contract.
#
# Build baseline:
#   west build -b qemu_cortex_m3 -s benches/flight_control \
#     -d /tmp/flight-baseline
#
# Build with Gale primitives:
#   west build -b qemu_cortex_m3 -s benches/flight_control \
#     -d /tmp/flight-gale \
#     -- -DZEPHYR_EXTRA_MODULES=<gale-root> \
#        -DOVERLAY_CONFIG=<gale>/benches/flight_control/prj-gale.conf

cmake_minimum_required(VERSION 3.20)

find_package(Zephyr REQUIRED HINTS $ENV{ZEPHYR_BASE})
project(gale_flight_control)

target_sources(app PRIVATE
  src/main.c
)
target_include_directories(app PRIVATE src)

# --------------------------------------------------------------------------
# GALE_FC_WASM_LTO (opt-in, default OFF): build the flight algorithm
# (filter_step + controller_step) via the wasm-cross-LTO pipeline
# (clang -> wasm-ld -> loom dissolve -> synth -> Cortex-M object) instead of
# the native src/control.c, so the bench measures the dissolved algorithm
# head-to-head with the native build. Cortex-M4F target (nucleo_g474re);
# needs clang(wasm32), wasm-ld, loom, synth on PATH. A thin r11=0 trampoline
# (wasm/control_wasm_tramp.S) bridges Zephyr's calling convention to synth's
# linear-memory-base addressing. Functionally verified identical to native
# (cmd=0x07FDF307 on the reference vector). See ../engine_control/silicon/.
# --------------------------------------------------------------------------
option(GALE_FC_WASM_LTO
  "Link filter_step/controller_step via wasm-cross-LTO (synth Cortex-M) instead of native C" OFF)

if(GALE_FC_WASM_LTO)
  find_program(GALE_WLTO_CLANG  clang   REQUIRED)
  find_program(GALE_WLTO_WASMLD wasm-ld REQUIRED)
  find_program(GALE_WLTO_LOOM   loom    REQUIRED)
  find_program(GALE_WLTO_SYNTH  synth   REQUIRED)
  set(_fc_src ${CMAKE_CURRENT_SOURCE_DIR}/src/control.c)
  set(_fc_o   ${CMAKE_CURRENT_BINARY_DIR}/control_wasm.o)
  add_custom_command(
    OUTPUT ${_fc_o}
    COMMENT "flight_control: dissolving control.c via wasm-cross-LTO (clang->wasm-ld->loom->synth)"
    COMMAND ${GALE_WLTO_CLANG} --target=wasm32-unknown-unknown -O2 -nostdlib
            -I${CMAKE_CURRENT_SOURCE_DIR}/src -c ${_fc_src} -o control.wasm.o
    COMMAND ${GALE_WLTO_WASMLD} --no-entry --export=filter_step --export=controller_step
            --allow-undefined --gc-sections control.wasm.o -o control.wasm
    COMMAND ${GALE_WLTO_LOOM} optimize control.wasm --passes inline --attestation false
            -o control.loom.wasm
    COMMAND ${GALE_WLTO_SYNTH} compile control.loom.wasm --target cortex-m4f
            --all-exports --relocatable -o control.synth.o
    COMMAND ${CMAKE_OBJCOPY} --redefine-sym filter_step=synth_filter_step
            --redefine-sym controller_step=synth_controller_step control.synth.o ${_fc_o}
    DEPENDS ${_fc_src}
    WORKING_DIRECTORY ${CMAKE_CURRENT_BINARY_DIR}
    VERBATIM)
  add_custom_target(gale_fc_control_wasm DEPENDS ${_fc_o})
  set_source_files_properties(${_fc_o} PROPERTIES EXTERNAL_OBJECT TRUE GENERATED TRUE)
  target_sources(app PRIVATE wasm/control_wasm_tramp.S ${_fc_o})
  add_dependencies(app gale_fc_control_wasm)
  message(STATUS "flight_control: GALE_FC_WASM_LTO ON — control.c via wasm-cross-LTO (cortex-m4f)")
else()
  target_sources(app PRIVATE src/control.c)
endif()

# -DENGINE_BENCH_TOTAL_SAMPLES / -DENGINE_BENCH_SWEEP override the
# defaults in main.c. Reuses the engine_control naming so existing
# CI plumbing (run_qemu_bench.sh, env conventions) translates 1:1.
if(DEFINED ENGINE_BENCH_TOTAL_SAMPLES)
  target_compile_definitions(app PRIVATE
    TOTAL_SAMPLES=${ENGINE_BENCH_TOTAL_SAMPLES}u)
endif()

if(DEFINED ENGINE_BENCH_SWEEP)
  target_compile_definitions(app PRIVATE
    ENGINE_BENCH_SWEEP_${ENGINE_BENCH_SWEEP}=1)
endif()
```

## prj.conf
```kconfig
# Flight-control macro-benchmark — base config.
#
# Same shape as engine_control's prj.conf with adds for the new
# primitives the macro bench exercises (mutex, msgq, condvar).
# Keeps CONFIG_GALE_KERNEL_* off by default; apply prj-gale.conf
# on the second build to swap in Gale primitives.

CONFIG_STDOUT_CONSOLE=y
CONFIG_MAIN_STACK_SIZE=4096
CONFIG_ISR_STACK_SIZE=2048

# The five primitives composing the bench.
CONFIG_RING_BUFFER=y
CONFIG_EVENTS=y

# Tick rate: 100 kHz so k_timer can express 1 kHz and 100 Hz periods
# without granularity loss. Same value engine_control uses.
CONFIG_SYS_CLOCK_TICKS_PER_SEC=100000

# Cycle counter accuracy is load-bearing for the four cycle deltas.
CONFIG_TIMING_FUNCTIONS=y

# No logging noise on the hot path. CSV emitted from reader thread.
CONFIG_LOG=n
CONFIG_CBPRINTF_NANO=y

# Mutex priority inheritance is on by default for K_MUTEX_DEFINE; the
# design depends on it (telemetry @ prio 9 must not starve when fusion
# @ prio 4 holds the state mutex while actuators run at 6/7/8).
# No explicit Kconfig — it's a kernel default.
```

## prj-gale.conf
```kconfig
# Flight-control macro-benchmark — Gale overlay.
#
# Applied on top of prj.conf to swap Gale's verified primitives into
# the entire control loop. The macro bench's whole point is that the
# slowdown from any single primitive may be invisible until they
# interact — so this overlay turns ALL FIVE on simultaneously.
#
# Variant matrix (from design doc Section 7):
#   baseline           — stock Zephyr (this overlay NOT applied)
#   gale-rustc         — this overlay
#   baseline-via-synth — synth-built C
#   gale-via-synth     — this overlay + -DGALE_USE_SYNTH=ON
#
# Usage:
#   west build -b qemu_cortex_m3 -s benches/flight_control \
#     -d /tmp/flight-gale \
#     -- -DZEPHYR_EXTRA_MODULES=<abs-path-to-gale> \
#        -DOVERLAY_CONFIG=benches/flight_control/prj-gale.conf

# Always-on (parity with engine_control's prj-gale.conf).
CONFIG_GALE_KERNEL_SEM=y
CONFIG_GALE_KERNEL_TIMER=y
CONFIG_GALE_KERNEL_SPINLOCK=y

# New for the macro bench.
CONFIG_GALE_KERNEL_MUTEX=y
CONFIG_GALE_KERNEL_MSGQ=y
CONFIG_GALE_KERNEL_CONDVAR=y
```

## src/control.c
```c
/*
 * SPDX-License-Identifier: Apache-2.0
 * Copyright (c) 2026 PulseEngine
 *
 * Flight-control algo: complementary filter + tiny PID-ish controller.
 * Pure integer arithmetic — no float, no divides in the hot path
 * (well, one shift-divide in the controller, deterministic). The
 * "algo" segment must be byte-identical baseline vs gale to pass the
 * integrity assert.
 */

#include "control.h"

/*
 * Complementary-filter weight: gyro contribution = 98 %, accel = 2 %.
 * Bias the filter toward gyro for a 1 kHz update — accel is mostly
 * gravity-correction. Encoded as permille so we keep integer math.
 */
#define ALPHA_GYRO_PERMILLE   980
#define ALPHA_ACCEL_PERMILLE  20

void filter_step(struct flight_state *st, const struct imu_sample *s)
{
	/*
	 * Tilt approximation from accel: small-angle / atan-free, valid
	 * for ±20° (sufficient for a smoke-bench). Convert milli-g →
	 * milli-deg by treating accel components as direct angle proxies
	 * (1 g full-tilt ≈ 1000 milli-deg in this synthetic workload).
	 */
	int32_t accel_pitch = s->accel_x;
	int32_t accel_roll  = s->accel_y;

	/* Integrate gyro: rate × dt where dt = 1 ms ⇒ contribution
	 * is rate / 1000. Use shift /1024 to keep it pure integer
	 * with negligible bias. */
	int32_t gyro_pitch = st->pitch_mdeg + (s->gyro_y >> 0);
	int32_t gyro_roll  = st->roll_mdeg  + (s->gyro_x >> 0);
	int32_t gyro_yaw   = st->yaw_mdeg   + (s->gyro_z >> 0);

	st->pitch_mdeg = (gyro_pitch * ALPHA_GYRO_PERMILLE
			  + accel_pitch * ALPHA_ACCEL_PERMILLE) / 1000;
	st->roll_mdeg  = (gyro_roll  * ALPHA_GYRO_PERMILLE
			  + accel_roll  * ALPHA_ACCEL_PERMILLE) / 1000;
	st->yaw_mdeg   = gyro_yaw;   /* yaw has no accel correction */

	st->pitch_rate = s->gyro_y;
	st->roll_rate  = s->gyro_x;
	st->yaw_rate   = s->gyro_z;
}

uint32_t controller_step(const struct flight_state *st)
{
	/*
	 * Synthetic three-axis controller: each effort in the range
	 * roughly [-128, +128], packed into 24 bits of a u32 (8 bits
	 * spare for a "command opcode" field). PID-ish but only P with
	 * a small D — verification-friendly bounded execution.
	 */
	int32_t aileron  = -(st->roll_mdeg  >> 6) - (st->roll_rate  >> 7);
	int32_t elevator = -(st->pitch_mdeg >> 6) - (st->pitch_rate >> 7);
	int32_t rudder   = -(st->yaw_mdeg   >> 6) - (st->yaw_rate   >> 7);

	if (aileron  >  127) aileron  =  127;
	if (aileron  < -127) aileron  = -127;
	if (elevator >  127) elevator =  127;
	if (elevator < -127) elevator = -127;
	if (rudder   >  127) rudder   =  127;
	if (rudder   < -127) rudder   = -127;

	uint32_t cmd = ((uint32_t)(uint8_t)(int8_t)aileron        )
		     | ((uint32_t)(uint8_t)(int8_t)elevator <<  8)
		     | ((uint32_t)(uint8_t)(int8_t)rudder   << 16)
		     | ((uint32_t)(st->updates & 0xFFu)     << 24);
	return cmd;
}
```
